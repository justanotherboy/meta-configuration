## conf/layer.conf
```bitbake
# We have a conf and classes directory, add to BBPATH
BBPATH .= ":${LAYERDIR}"

# We have recipes-* directories, add to BBFILES
BBFILES += "${LAYERDIR}/recipes-*/*/*.bb \
	${LAYERDIR}/recipes-*/*/*.bbappend"

BBFILE_COLLECTIONS += "meta-configuration"
BBFILE_PATTERN_meta-configuration = "^${LAYERDIR}/"
# This layer is about configuration, so there are no recipes
BBFILE_PATTERN_IGNORE_EMPTY_meta-configuration = "1"
BBFILE_PRIORITY_meta-configuration = "6"

LAYERSERIES_COMPAT_meta-configuration = "warrior"

# This should only be incremented on significant changes that will
# cause compatibility issues with other layer
LAYERVERSION_meta-configuration = "1"

LAYERDEPENDS_meta-configuration = "core"
```
